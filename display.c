#include "display.h"
#include "driver/i2s.h"
#include "driver/i2c.h"
#include "esp_log.h"
#include <string.h>

static const char *TAG = "DISPLAY";

#define OLED_I2C_PORT I2C_NUM_0
#define OLED_ADDR     0x3C

// Minimal 5x8 font for ASCII 32 to 127
static const uint8_t font5x8[][5] = {
    {0x00,0x00,0x00,0x00,0x00}, // Space
    {0x00,0x00,0x5f,0x00,0x00}, // !
    {0x00,0x07,0x00,0x07,0x00}, // "
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    {0x10,0x08,0x08,0x10,0x08}, // ~
};

static void oled_send_cmd(uint8_t cmd) {
    i2c_cmd_handle_t cmd_h = i2c_cmd_link_create();
    i2c_master_start(cmd_h);
    i2c_master_write_byte(cmd_h, (OLED_ADDR << 1) | I2C_MASTER_WRITE, true);
    i2c_master_write_byte(cmd_h, 0x00, true); // command stream
    i2c_master_write_byte(cmd_h, cmd, true);
    i2c_master_stop(cmd_h);
    i2c_master_cmd_begin(OLED_I2C_PORT, cmd_h, 10 / portTICK_PERIOD_MS);
    i2c_cmd_link_delete(cmd_h);
}

static void oled_send_data(uint8_t *data, size_t size) {
    i2c_cmd_handle_t cmd_h = i2c_cmd_link_create();
    i2c_master_start(cmd_h);
    i2c_master_write_byte(cmd_h, (OLED_ADDR << 1) | I2C_MASTER_WRITE, true);
    i2c_master_write_byte(cmd_h, 0x40, true); // data stream
    i2c_master_write(cmd_h, data, size, true);
    i2c_master_stop(cmd_h);
    i2c_master_cmd_begin(OLED_I2C_PORT, cmd_h, 10 / portTICK_PERIOD_MS);
    i2c_cmd_link_delete(cmd_h);
}

esp_err_t display_init(void) {
    // SSD1306 Init sequence
    uint8_t init_cmds[] = {
        0xAE, 0xD5, 0x80, 0xA8, 0x3F, 0xD3, 0x00, 0x40,
        0x8D, 0x14, 0x20, 0x00, 0xA1, 0xC8, 0xDA, 0x12,
        0x81, 0xCF, 0xD9, 0xF1, 0xDB, 0x40, 0xA4, 0xA6, 0xAF
    };
    for (int i = 0; i < sizeof(init_cmds); i++) oled_send_cmd(init_cmds[i]);
    display_clear();
    return ESP_OK;
}

void display_clear(void) {
    uint8_t empty[128] = {0};
    for (int i = 0; i < 8; i++) {
        oled_send_cmd(0xB0 + i);
        oled_send_cmd(0x00);
        oled_send_cmd(0x10);
        oled_send_data(empty, 128);
    }
}

void display_print_line(int line, const char *text) {
    if (line > 7) return;
    oled_send_cmd(0xB0 + line);
    oled_send_cmd(0x00);
    oled_send_cmd(0x10);
    uint8_t buffer[128] = {0};
    int p = 0;
    while (*text && p < 120) {
        char c = *text++;
        if (c >= 32 && c <= 126) {
            memcpy(&buffer[p], font5x8[c - 32], 5);
        }
        p += 6; // 5 cols + 1 space
    }
    oled_send_data(buffer, 128);
}

void display_update_status(const char *ip, const char *sip_status, const char *caller) {
    display_print_line(0, "ESP32 SIP Phone");
    display_print_line(2, "IP Address:");
    display_print_line(3, ip ? ip : "Connecting...");
    display_print_line(5, "SIP Status:");
    display_print_line(6, sip_status ? sip_status : "Unknown");
    if (caller && strlen(caller) > 0) {
        display_print_line(7, caller);
    } else {
        display_print_line(7, " ");
    }
}
