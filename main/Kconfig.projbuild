## main/Kconfig.projbuild
```kconfig
menu "ESP32 SIP Voice Configuration"

    choice SIP_HARDWARE_PROFILE
        prompt "Hardware Capability Profile"
        default SIP_PROFILE_STANDARD
        help
            Select the hardware tier. This enables/disables heavy features like OPUS and AEC
            based on your hardware capabilities to save memory and flash.

        config SIP_PROFILE_LITE
            bool "LITE (ESP32-C3 / Old ESP32 without PSRAM)"
            help
                Basic SIP client. Uses G.711/G.722 only. Small SRAM-based Jitter Buffer.
                No OPUS, no AEC, minimal UI. Best for resource-constrained chips.

        config SIP_PROFILE_STANDARD
            bool "STANDARD (ESP32 with PSRAM)"
            help
                Full GUI with LVGL, large PSRAM-based Jitter Buffer, G.722 HD Voice.
                Software Echo Suppression. Recommended for typical ESP32 WROVER boards.

        config SIP_PROFILE_PRO
            bool "PRO / AI (ESP32-S3 with PSRAM)"
            help
                Enables Ultra-HD OPUS Codec, Full-Duplex AEC (esp-sr), and Wake Word detection.
                Requires ESP32-S3 vector instructions and external PSRAM.
    endchoice

endmenu
```

## sdkconfig.defaults
```kconfig
# ===== ESP32-SIP-Voice default project configuration =====
# Override per-board with `idf.py menuconfig`.

# Custom partition table (factory app + WakeNet model partition)
CONFIG_PARTITION_TABLE_CUSTOM=y
CONFIG_PARTITION_TABLE_CUSTOM_FILENAME="partitions.csv"

# 8 MB flash assumed (needed for the WakeNet model partition). Drop to your
# board's size if you disable wake word.
CONFIG_ESPTOOLPY_FLASHSIZE_8MB=y

# 1 kHz tick -> accurate 20 ms audio framing (pdMS_TO_TICKS(20) == 20 ticks).
CONFIG_FREERTOS_HZ=1000

# Bigger main task stack for init of audio + SIP + UI.
CONFIG_ESP_MAIN_TASK_STACK_SIZE=8192

# esp-sr: load WakeNet models from the SPIFFS "model" partition.
CONFIG_MODEL_IN_SPIFFS=y

# ---- Recommended for STANDARD/PRO tiers (boards WITH PSRAM) ----
# Uncomment on ESP32-WROVER / ESP32-S3 modules that have external PSRAM so the
# large jitter buffer and (PRO) OPUS/AEC have room.
# CONFIG_SPIRAM=y
# CONFIG_SPIRAM_USE_MALLOC=y
```
